## board/google/oriole/Kconfig
```kconfig
if TARGET_ORIOLE

config SYS_BOARD
	default "oriole"

config SYS_VENDOR
	default "google"

config SYS_CONFIG_NAME
	default "oriole"

endif
```

## configs/oriole_defconfig
```kconfig
CONFIG_ARM=y
CONFIG_ARCH_EXYNOS=y
CONFIG_TEXT_BASE=0x0
CONFIG_POSITION_INDEPENDENT=y
CONFIG_SYS_MALLOC_LEN=0x2000000
CONFIG_SYS_MALLOC_F_LEN=0x4000
CONFIG_ARCH_EXYNOS9=y
CONFIG_TARGET_ORIOLE=y
CONFIG_NR_DRAM_BANKS=8
CONFIG_SYS_LOAD_ADDR=0x80000000
CONFIG_DEFAULT_DEVICE_TREE="exynos/google/gs101-oriole"
CONFIG_OF_UPSTREAM=y
CONFIG_SYS_PROMPT="oriole# "
CONFIG_BOARD_LATE_INIT=y
CONFIG_DM=y
CONFIG_OF_CONTROL=y
CONFIG_VIDEO=y
CONFIG_VIDEO_SIMPLE=y
CONFIG_SYS_WHITE_ON_BLACK=y
# CONFIG_DISPLAY_CPUINFO is not set
# CONFIG_NET is not set
# CONFIG_MMC is not set
# CONFIG_S5P_SERIAL is not set
CONFIG_BOARD_EARLY_INIT_F=y
CONFIG_CONSOLE_MUX=y
CONFIG_SYS_CONSOLE_IS_IN_ENV=y
CONFIG_USB=y
CONFIG_DM_USB_GADGET=y
CONFIG_USB_DWC3=y
CONFIG_USB_DWC3_GADGET=y
CONFIG_MISC=y
CONFIG_USB_DWC3_GENERIC=y
CONFIG_USB_GADGET=y
CONFIG_USB_GADGET_MANUFACTURER="Google"
CONFIG_USB_GADGET_VENDOR_NUM=0x18d1
CONFIG_USB_GADGET_PRODUCT_NUM=0x4ee0
CONFIG_USB_GADGET_DOWNLOAD=y
CONFIG_USB_FUNCTION_ACM=y
# CONFIG_REQUIRE_SERIAL_CONSOLE is not set
CONFIG_BOARD_EARLY_INIT_R=y
CONFIG_MISC_INIT_R=y
CONFIG_CYCLIC=y
# boot trace: CONFIG_DEBUG_UART=y
# boot trace: CONFIG_DEBUG_UART_ORIOLE_FB=y
# boot trace: CONFIG_DEBUG_UART_BASE=0xfac00000
# boot trace: CONFIG_DEBUG_UART_CLOCK=0
# boot trace: CONFIG_DEBUG_UART_ANNOUNCE=y
# CONFIG_SERIAL_PRESENT is not set
CONFIG_SCSI=y
CONFIG_DM_SCSI=y
CONFIG_UFS=y
CONFIG_UFS_GS101=y
CONFIG_CMD_UFS=y
CONFIG_CMD_SCSI=y
CONFIG_CMD_PART=y
CONFIG_CMD_FS_GENERIC=y
CONFIG_CMD_EXT4=y
CONFIG_CMD_FAT=y
CONFIG_FS_EXT4=y
CONFIG_FS_FAT=y
CONFIG_BLKMAP=y
CONFIG_CMD_BLKMAP=y
CONFIG_PARTITIONS=y
CONFIG_EFI_PARTITION=y
# CONFIG_DEBUG_UART is not set
CONFIG_PRE_CONSOLE_BUFFER=y
CONFIG_PRE_CON_BUF_ADDR=0x9f000000
CONFIG_PRE_CON_BUF_SZ=8192
CONFIG_SYSRESET=y
# CONFIG_SYSRESET_PSCI is not set
CONFIG_CMD_POWEROFF=y
CONFIG_CMD_BOOTMENU=y
CONFIG_BOOTDELAY=0
CONFIG_OF_BOARD_SETUP=y
CONFIG_SYS_FDT_PAD=0x10000
CONFIG_HUSH_PARSER=y
CONFIG_SUPPORT_RAW_INITRD=y
```
